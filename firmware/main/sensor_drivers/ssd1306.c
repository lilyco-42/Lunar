#include "ssd1306.h"
#include "config.h"
#include "esp_log.h"
#include <string.h>

static const char *TAG = "oled";

// ────────────────────────────────────────────────────
// 5x7 ASCII font (0x20–0x7F), 5 bytes per glyph
// Columns are left-justified; trailing column is implicit blank
// ────────────────────────────────────────────────────
static const uint8_t font5x7[][5] = {
    /* 0x20 ' ' */ {0x00, 0x00, 0x00, 0x00, 0x00},
    /* 0x21 '!' */ {0x00, 0x00, 0x5F, 0x00, 0x00},
    /* 0x22 '"' */ {0x00, 0x07, 0x00, 0x07, 0x00},
    /* 0x23 '#' */ {0x14, 0x7F, 0x14, 0x7F, 0x14},
    /* 0x24 '$' */ {0x24, 0x2A, 0x7F, 0x2A, 0x12},
    /* 0x25 '%' */ {0x23, 0x13, 0x08, 0x64, 0x62},
    /* 0x26 '&' */ {0x36, 0x49, 0x55, 0x22, 0x50},
    /* 0x27 ''' */ {0x00, 0x05, 0x03, 0x00, 0x00},
    /* 0x28 '(' */ {0x00, 0x1C, 0x22, 0x41, 0x00},
    /* 0x29 ')' */ {0x00, 0x41, 0x22, 0x1C, 0x00},
    /* 0x2A '*' */ {0x08, 0x2A, 0x1C, 0x2A, 0x08},
    /* 0x2B '+' */ {0x08, 0x08, 0x3E, 0x08, 0x08},
    /* 0x2C ',' */ {0x00, 0x50, 0x30, 0x00, 0x00},
    /* 0x2D '-' */ {0x08, 0x08, 0x08, 0x08, 0x08},
    /* 0x2E '.' */ {0x00, 0x60, 0x60, 0x00, 0x00},
    /* 0x2F '/' */ {0x20, 0x10, 0x08, 0x04, 0x02},
    /* 0x30 '0' */ {0x3E, 0x51, 0x49, 0x45, 0x3E},
    /* 0x31 '1' */ {0x00, 0x42, 0x7F, 0x40, 0x00},
    /* 0x32 '2' */ {0x42, 0x61, 0x51, 0x49, 0x46},
    /* 0x33 '3' */ {0x21, 0x41, 0x45, 0x4B, 0x31},
    /* 0x34 '4' */ {0x18, 0x14, 0x12, 0x7F, 0x10},
    /* 0x35 '5' */ {0x27, 0x45, 0x45, 0x45, 0x39},
    /* 0x36 '6' */ {0x3C, 0x4A, 0x49, 0x49, 0x30},
    /* 0x37 '7' */ {0x01, 0x71, 0x09, 0x05, 0x03},
    /* 0x38 '8' */ {0x36, 0x49, 0x49, 0x49, 0x36},
    /* 0x39 '9' */ {0x06, 0x49, 0x49, 0x29, 0x1E},
    /* 0x3A ':' */ {0x00, 0x36, 0x36, 0x00, 0x00},
    /* 0x3B ';' */ {0x00, 0x56, 0x36, 0x00, 0x00},
    /* 0x3C '<' */ {0x00, 0x08, 0x14, 0x22, 0x41},
    /* 0x3D '=' */ {0x14, 0x14, 0x14, 0x14, 0x14},
    /* 0x3E '>' */ {0x41, 0x22, 0x14, 0x08, 0x00},
    /* 0x3F '?' */ {0x02, 0x01, 0x51, 0x09, 0x06},
    /* 0x40 '@' */ {0x32, 0x49, 0x79, 0x41, 0x3E},
    /* 0x41 'A' */ {0x7E, 0x11, 0x11, 0x11, 0x7E},
    /* 0x42 'B' */ {0x7F, 0x49, 0x49, 0x49, 0x36},
    /* 0x43 'C' */ {0x3E, 0x41, 0x41, 0x41, 0x22},
    /* 0x44 'D' */ {0x7F, 0x41, 0x41, 0x22, 0x1C},
    /* 0x45 'E' */ {0x7F, 0x49, 0x49, 0x49, 0x41},
    /* 0x46 'F' */ {0x7F, 0x09, 0x09, 0x01, 0x01},
    /* 0x47 'G' */ {0x3E, 0x41, 0x41, 0x51, 0x32},
    /* 0x48 'H' */ {0x7F, 0x08, 0x08, 0x08, 0x7F},
    /* 0x49 'I' */ {0x00, 0x41, 0x7F, 0x41, 0x00},
    /* 0x4A 'J' */ {0x20, 0x40, 0x41, 0x3F, 0x01},
    /* 0x4B 'K' */ {0x7F, 0x08, 0x14, 0x22, 0x41},
    /* 0x4C 'L' */ {0x7F, 0x40, 0x40, 0x40, 0x40},
    /* 0x4D 'M' */ {0x7F, 0x02, 0x04, 0x02, 0x7F},
    /* 0x4E 'N' */ {0x7F, 0x04, 0x08, 0x10, 0x7F},
    /* 0x4F 'O' */ {0x3E, 0x41, 0x41, 0x41, 0x3E},
    /* 0x50 'P' */ {0x7F, 0x09, 0x09, 0x09, 0x06},
    /* 0x51 'Q' */ {0x3E, 0x41, 0x51, 0x21, 0x5E},
    /* 0x52 'R' */ {0x7F, 0x09, 0x19, 0x29, 0x46},
    /* 0x53 'S' */ {0x46, 0x49, 0x49, 0x49, 0x31},
    /* 0x54 'T' */ {0x01, 0x01, 0x7F, 0x01, 0x01},
    /* 0x55 'U' */ {0x3F, 0x40, 0x40, 0x40, 0x3F},
    /* 0x56 'V' */ {0x1F, 0x20, 0x40, 0x20, 0x1F},
    /* 0x57 'W' */ {0x7F, 0x20, 0x18, 0x20, 0x7F},
    /* 0x58 'X' */ {0x63, 0x14, 0x08, 0x14, 0x63},
    /* 0x59 'Y' */ {0x03, 0x04, 0x78, 0x04, 0x03},
    /* 0x5A 'Z' */ {0x61, 0x51, 0x49, 0x45, 0x43},
    /* 0x5B '[' */ {0x00, 0x00, 0x7F, 0x41, 0x41},
    /* 0x5C '\' */ {0x02, 0x04, 0x08, 0x10, 0x20},
    /* 0x5D ']' */ {0x41, 0x41, 0x7F, 0x00, 0x00},
    /* 0x5E '^' */ {0x04, 0x02, 0x01, 0x02, 0x04},
    /* 0x5F '_' */ {0x40, 0x40, 0x40, 0x40, 0x40},
    /* 0x60 '`' */ {0x00, 0x01, 0x02, 0x04, 0x00},
    /* 0x61 'a' */ {0x20, 0x54, 0x54, 0x54, 0x78},
    /* 0x62 'b' */ {0x7F, 0x48, 0x44, 0x44, 0x38},
    /* 0x63 'c' */ {0x38, 0x44, 0x44, 0x44, 0x20},
    /* 0x64 'd' */ {0x38, 0x44, 0x44, 0x48, 0x7F},
    /* 0x65 'e' */ {0x38, 0x54, 0x54, 0x54, 0x18},
    /* 0x66 'f' */ {0x08, 0x7E, 0x09, 0x01, 0x02},
    /* 0x67 'g' */ {0x08, 0x14, 0x54, 0x54, 0x3C},
    /* 0x68 'h' */ {0x7F, 0x08, 0x04, 0x04, 0x78},
    /* 0x69 'i' */ {0x00, 0x44, 0x7D, 0x40, 0x00},
    /* 0x6A 'j' */ {0x20, 0x40, 0x44, 0x3D, 0x00},
    /* 0x6B 'k' */ {0x00, 0x7F, 0x10, 0x28, 0x44},
    /* 0x6C 'l' */ {0x00, 0x41, 0x7F, 0x40, 0x00},
    /* 0x6D 'm' */ {0x7C, 0x04, 0x18, 0x04, 0x78},
    /* 0x6E 'n' */ {0x7C, 0x08, 0x04, 0x04, 0x78},
    /* 0x6F 'o' */ {0x38, 0x44, 0x44, 0x44, 0x38},
    /* 0x70 'p' */ {0x7C, 0x14, 0x14, 0x14, 0x08},
    /* 0x71 'q' */ {0x08, 0x14, 0x14, 0x18, 0x7C},
    /* 0x72 'r' */ {0x7C, 0x08, 0x04, 0x04, 0x08},
    /* 0x73 's' */ {0x48, 0x54, 0x54, 0x54, 0x20},
    /* 0x74 't' */ {0x04, 0x3F, 0x44, 0x40, 0x20},
    /* 0x75 'u' */ {0x3C, 0x40, 0x40, 0x20, 0x7C},
    /* 0x76 'v' */ {0x1C, 0x20, 0x40, 0x20, 0x1C},
    /* 0x77 'w' */ {0x3C, 0x40, 0x30, 0x40, 0x3C},
    /* 0x78 'x' */ {0x44, 0x28, 0x10, 0x28, 0x44},
    /* 0x79 'y' */ {0x0C, 0x50, 0x50, 0x50, 0x3C},
    /* 0x7A 'z' */ {0x44, 0x64, 0x54, 0x4C, 0x44},
    /* 0x7B '{' */ {0x00, 0x08, 0x36, 0x41, 0x00},
    /* 0x7C '|' */ {0x00, 0x00, 0x7F, 0x00, 0x00},
    /* 0x7D '}' */ {0x00, 0x41, 0x36, 0x08, 0x00},
    /* 0x7E '~' */ {0x08, 0x04, 0x08, 0x10, 0x08},
    /* 0x7F DEL */ {0x00, 0x00, 0x00, 0x00, 0x00},
};

// ────────────────────────────────────────────────────
// I2C helpers  (caller must init I2C bus first)
// ────────────────────────────────────────────────────
static void send_cmd(uint8_t cmd)
{
    uint8_t buf[2] = {0x00, cmd};
    i2c_master_write_to_device(I2C_MASTER_PORT, OLED_I2C_ADDR,
                               buf, 2, pdMS_TO_TICKS(100));
}

static void send_data(const uint8_t *data, size_t len)
{
    if (len == 0) return;
    uint8_t *buf = malloc(len + 1);
    if (!buf) return;
    buf[0] = 0x40;
    memcpy(buf + 1, data, len);
    i2c_master_write_to_device(I2C_MASTER_PORT, OLED_I2C_ADDR,
                               buf, len + 1, pdMS_TO_TICKS(100));
    free(buf);
}

static void set_page_addr(uint8_t page, uint8_t col)
{
    send_cmd(0xB0 | (page & 0x07));   // set page
    send_cmd(0x00 | (col & 0x0F));    // set lower column
    send_cmd(0x10 | ((col >> 4) & 0x0F)); // set higher column
}

// ────────────────────────────────────────────────────
// Public API
// ────────────────────────────────────────────────────

void oled_init(void)
{
    // SSD1306 init sequence for 128x64
    // Caller must have already initialized the I2C bus.
    send_cmd(0xAE); // display off
    send_cmd(0xD5); send_cmd(0x80); // clock div ratio
    send_cmd(0xA8); send_cmd(0x3F); // mux ratio = 63
    send_cmd(0xD3); send_cmd(0x00); // display offset = 0
    send_cmd(0x40); // start line = 0
    send_cmd(0x8D); send_cmd(0x14); // charge pump on
    send_cmd(0x20); send_cmd(0x00); // horizontal addressing
    send_cmd(0xA1); // segment remap (left-right flip)
    send_cmd(0xC8); // COM scan dir (bottom-up flip)
    send_cmd(0xDA); send_cmd(0x12); // COM pins HW config
    send_cmd(0x81); send_cmd(0xCF); // contrast
    send_cmd(0xD9); send_cmd(0xF1); // pre-charge period
    send_cmd(0xDB); send_cmd(0x40); // VCOMH deselect level
    send_cmd(0xA4); // resume from sleep
    send_cmd(0xA6); // normal (non-inverted)
    send_cmd(0x2E); // deactivate scroll
    send_cmd(0xAF); // display on

    oled_clear();
    ESP_LOGI(TAG, "SSD1306 initialized, I2C addr 0x%02X", OLED_I2C_ADDR);
}

void oled_clear(void)
{
    for (int page = 0; page < 8; page++) {
        set_page_addr(page, 0);
        uint8_t zeros[128] = {0};
        send_data(zeros, 128);
    }
}

void oled_show_text(int line, const char *text)
{
    if (line < 0 || line > 7) return;

    uint8_t buf[128];
    memset(buf, 0, sizeof(buf));

    int col = 0;
    while (*text && col < 128) {
        int idx = (unsigned char)*text - 0x20;
        if (idx >= 0 && idx < 96) {
            for (int i = 0; i < 5 && col < 128; i++) {
                buf[col++] = font5x7[idx][i];
            }
            // 1-pixel inter-char gap
            if (col < 128) col++;
        }
        text++;
    }

    set_page_addr(line, 0);
    send_data(buf, 128);
}

void oled_show_two_lines(const char *line1, const char *line2)
{
    oled_show_text(0, line1);
    oled_show_text(1, line2);
}

/*
 * Render a 16x16 glyph stored in SSD1306-native page format:
 *   glyph[0..15]:  top page (rows 0-7), 16 columns, bit0 = top of page
 *   glyph[16..31]: bottom page (rows 8-15), 16 columns
 */
void oled_show_glyph16(int page, int col, const uint8_t glyph[32])
{
    set_page_addr(page, col);
    send_data(glyph, 16);

    set_page_addr(page + 1, col);
    send_data(glyph + 16, 16);
}

void oled_write_bitmap(int page, int col, const uint8_t *data, int len)
{
    int bytes_per_page = 128 - col;
    if (bytes_per_page <= 0) return;

    while (len > 0 && page < 8) {
        int chunk = len;
        if (chunk > bytes_per_page) chunk = bytes_per_page;
        set_page_addr(page, col);
        send_data(data, chunk);
        data += chunk;
        len -= chunk;
        page++;
        col = 0;
        bytes_per_page = 128;
    }
}

#include "oled_cn_font.h"

/* Decode one UTF-8 code point (1-4 bytes), advance *s */
static uint32_t utf8_next(const char **s)
{
    const uint8_t *p = (const uint8_t *)*s;
    uint32_t cp;

    if (*p < 0x80) {
        (*s)++;
        return *p;
    }
    if ((*p & 0xE0) == 0xC0 && (p[1] & 0xC0) == 0x80) {
        cp = (*p & 0x1F) << 6 | (p[1] & 0x3F);
        *s += 2;
        return cp;
    }
    if ((*p & 0xF0) == 0xE0 && (p[1] & 0xC0) == 0x80 && (p[2] & 0xC0) == 0x80) {
        cp = (*p & 0x0F) << 12 | (p[1] & 0x3F) << 6 | (p[2] & 0x3F);
        *s += 3;
        return cp;
    }
    if ((*p & 0xF8) == 0xF0 && (p[1] & 0xC0) == 0x80 && (p[2] & 0xC0) == 0x80 && (p[3] & 0xC0) == 0x80) {
        cp = (*p & 0x07) << 18 | (p[1] & 0x3F) << 12 | (p[2] & 0x3F) << 6 | (p[3] & 0x3F);
        *s += 4;
        return cp;
    }
    (*s)++;
    return 0;
}

int oled_show_utf8(int page, const char *text, int max_width)
{
    int col = 0;
    const char *p = text;

    while (*p && (max_width == 0 || col < max_width)) {
        uint32_t cp = utf8_next(&p);
        if (cp == 0) continue;

        if (cp < 0x80) {
            /* ASCII — render inline (5px + 1px gap) */
            int idx = (int)cp - 0x20;
            if (idx >= 0 && idx < 96 && col + 6 <= 128) {
                uint8_t buf[6];
                for (int i = 0; i < 5; i++) buf[i] = font5x7[idx][i];
                buf[5] = 0; /* inter-char gap */
                set_page_addr(page, col);
                send_data(buf, 6);
                col += 6;
            } else {
                col += 6;
            }
        } else {
            /* Try Chinese font lookup */
            int gi = cn_font_lookup(cp);
            if (gi >= 0 && page < 7 && col + 16 <= 128) {
                oled_show_glyph16(page, col, cn_font_16x16[gi]);
                col += 17; /* 16px glyph + 1px gap */
            } else {
                /* Fallback: show '?' */
                col += 6;
            }
        }
    }
    return col;
}
